## app/dts/bindings/behaviors/zmk,behavior-vol-shift.yaml
```yaml
# Copyright (c) 2026 thoughtfix
# SPDX-License-Identifier: MIT

description: Volume Down / Shift-Volume-Up behavior with proper Shift-bit release

compatible: "zmk,behavior-vol-shift"

include: zero_param.yaml
```
